## config/boards/shields/a_ball/Kconfig.defconfig
```kconfig
if SHIELD_A_BALL

config ZMK_KEYBOARD_NAME
    default "a_ball"
# Other keyboard settings

config ZMK_POINTING
    default y

# Assuming pointing device uses SPI
config SPI
    default y

# Reducing the USB polling rate from 1000Hz (default value of 1) to 100Hz
config USB_HID_POLL_INTERVAL_MS
	default 10

endif 
```
